## prj.conf
```kconfig
#
# Hardware settings
#

CONFIG_GPIO=y
CONFIG_NRFX_PDM=y
CONFIG_FLASH=y
CONFIG_FLASH_MAP=y
CONFIG_FLASH_PAGE_LAYOUT=y
CONFIG_NVS=y
CONFIG_ADC=y

# To flash via dev board
#CONFIG_BUILD_OUTPUT_UF2=n
#CONFIG_USE_DT_CODE_PARTITION=n
# Watchdog Timer
CONFIG_WATCHDOG=y
CONFIG_WDT_DISABLE_AT_BOOT=n

#
# Bluetooth settings
#

CONFIG_BT=y
CONFIG_BT_PERIPHERAL=y
CONFIG_BT_DEVICE_NAME="Pinclaw"
CONFIG_BT_DEVICE_NAME_DYNAMIC=y
CONFIG_BT_DEVICE_NAME_MAX=20
CONFIG_BT_MAX_CONN=3
# CONFIG_BT_EXT_ADV_MAX_ADV_SET=2
CONFIG_BT_MAX_PAIRED=1
CONFIG_BT_DEVICE_APPEARANCE=22
CONFIG_BT_GATT_DYNAMIC_DB=y

# Preferred connection parameters — keeps BLE alive during iOS background/sleep
# Without these, iOS picks a short supervision timeout and disconnects after ~minutes
CONFIG_BT_PERIPHERAL_PREF_MIN_INT=24
CONFIG_BT_PERIPHERAL_PREF_MAX_INT=40
CONFIG_BT_PERIPHERAL_PREF_LATENCY=4
CONFIG_BT_PERIPHERAL_PREF_TIMEOUT=600

#
# Max transmit power supported by nRF52840
#

CONFIG_BT_CTLR_TX_PWR_ANTENNA=8
CONFIG_BT_PHY_UPDATE=y

#
# Battery and Device Information services
#

CONFIG_BT_BAS=y
CONFIG_BT_DIS=y
CONFIG_BT_DIS_PNP=n
CONFIG_BT_DIS_MODEL="Pinclaw Clip"
CONFIG_BT_DIS_MANUF="Pinclaw"
CONFIG_BT_DIS_FW_REV=y
CONFIG_BT_DIS_HW_REV=y
CONFIG_BT_DIS_FW_REV_STR="2.2.4"
CONFIG_BT_DIS_HW_REV_STR="Seeed Xiao BLE Sense"

#
# Large BLE packets / BLE Buffers 
#
# CONFIG_BT_GATT_CLIENT=y
# CONFIG_BT_THROUGHPUT=y

CONFIG_BT_L2CAP_TX_MTU=498

CONFIG_BT_CTLR_DATA_LENGTH_MAX=251
CONFIG_BT_CTLR_PHY_2M=y
CONFIG_BT_CTLR_PHY_CODED=y
CONFIG_BT_CTLR_SDC_MAX_CONN_EVENT_LEN_DEFAULT=400000
CONFIG_BT_CONN_TX_MAX=20
CONFIG_BT_BUF_ACL_RX_SIZE=1024
CONFIG_BT_L2CAP_TX_BUF_COUNT=10
CONFIG_BT_BUF_ACL_TX_SIZE=2048
# CONFIG_BT_ATT_TX_COUNT=10
# CONFIG_BT_EXT_ADV=y
# CONFIG_BT_PER_ADV=y
# CONFIG_BT_OBSERVER=y
# CONFIG_BT_ATT_PREPARE_COUNT=2
CONFIG_BT_USER_DATA_LEN_UPDATE=y
CONFIG_BT_AUTO_DATA_LEN_UPDATE=y
CONFIG_BT_USER_PHY_UPDATE=y
CONFIG_BT_AUTO_PHY_UPDATE=y

CONFIG_FPU=y
# CONFIG_NORDIC_QSPI_NOR — enabled below in MCUboot section
# CONFIG_BOARD_ENABLE_DCDC=y
#

#
# Console
#
# Disable the lines to enable console log
CONFIG_CONSOLE=y
CONFIG_PRINTK=y

#
# Logs
#

# Enable the lines below to enable logs via UART/USB
CONFIG_LOG=y
CONFIG_LOG_PRINTK=y
CONFIG_UART_CONSOLE=y
# CONFIG_LOG_PROCESS_THREAD_PRIORITY=5
# CONFIG_LOG_PROCESS_THREAD_CUSTOM_PRIORITY=y

# Enable the lines below to enable debug logs
# Warn: Level 4 is the cause of crashing
CONFIG_LOG_DEFAULT_LEVEL=3

#
# Log level and buffer size
#

# CONFIG_LOG_OVERRIDE_LEVEL=4
# CONFIG_LOG_BUFFER_SIZE=32000
CONFIG_LOG_PROCESS_THREAD_STACK_SIZE=2048

#
# Debug
#

# CONFIG_DEBUG=y
# CONFIG_DEBUG_OPTIMIZATIONS=y
# CONFIG_SERIAL=y

#
# Debug (This value breaks some builds)
#

# CONFIG_ASSERT=y

# Auto-reset on fatal errors (BLE controller assert, k_panic, etc.)
# Without this, the device hangs silently with BLE dead but LEDs still running.
CONFIG_RESET_ON_FATAL_ERROR=y

#
# BT log configuration
#

# CONFIG_BT_DEBUG_LOG=y
# CONFIG_BT_L2CAP_LOG_LEVEL_DBG=y
# CONFIG_BT_LOG_LEVEL_DBG=y

# CONFIG_BT_RX_STACK_SIZE=4096
# CONFIG_BT_CTLR_RX_PRIO_STACK_SIZE=4096
# CONFIG_BT_DEBUG_LOG=y
# CONFIG_BT_RX_STACK_SIZE=4096
# CONFIG_BT_CTLR_RX_PRIO_STACK_SIZE=4096

#
# SD Card Support (all devices required)
#

CONFIG_DISK_ACCESS=n
CONFIG_FILE_SYSTEM=n
CONFIG_FAT_FILESYSTEM_ELM=n
CONFIG_FS_FATFS_MOUNT_MKFS=n
CONFIG_FS_FATFS_EXFAT=n
#nessessary?
CONFIG_MAIN_STACK_SIZE=2048
# CONFIG_DISK_DRIVER_SDMMC=y
# CONFIG_SPI=y
CONFIG_HEAP_MEM_POOL_SIZE=4096

#
# Disable unused peripherals
#
CONFIG_I2C=n
# CONFIG_NRFX_TWIM0=n
# CONFIG_NRFX_TWIM1=n

#
# LSM6DSL sensor (accelerometer and gyroscope)
#
CONFIG_LSM6DSL=n
CONFIG_LSM6DSL_ENABLE_TEMP=n
# CONFIG_LSM6DSL_TRIGGER_GLOBAL_THREAD=y
CONFIG_SENSOR=n

#
# Speaker
#
CONFIG_I2S=y
CONFIG_I2S_NRFX=y
CONFIG_SPI=y
CONFIG_SPI_NRFX=y

#
# NFC (in the future)
#

# CONFIG_NFC_T2T_NRFXLIB=y
# CONFIG_NFC_NDEF=y
# CONFIG_NFC_NDEF_MSG=y
# CONFIG_NFC_NDEF_RECORD=y
# CONFIG_NFC_NDEF_URI_MSG=y
# CONFIG_NFC_NDEF_URI_REC=y
# CONFIG_HWINFO=y

#
#EVERYTHING ELSE
#

CONFIG_RING_BUFFER=y

CONFIG_PM_DEVICE=y
# CONFIG_NRFX_USBD=y

# CONFIG_FLASH=y

#
# Omi features configuration
#

CONFIG_OMI_CODEC_OPUS=y
CONFIG_OMI_ENABLE_OFFLINE_STORAGE=n
CONFIG_OMI_ENABLE_ACCELEROMETER=n
CONFIG_OMI_ENABLE_BUTTON=y
CONFIG_OMI_ENABLE_SPEAKER=y
CONFIG_OMI_ENABLE_BATTERY=y
CONFIG_OMI_ENABLE_USB=y
CONFIG_OMI_ENABLE_HAPTIC=n
CONFIG_SERIAL=y
CONFIG_BT_GATT_CLIENT=y

# OTA (MCUboot + MCUmgr) configs moved to prj_ota.conf
# Build with: west build ... -- -DOVERLAY_CONFIG=prj_ota.conf
```

## src/main.c
```c
#include <stdlib.h>
#include <string.h>
#include <zephyr/drivers/uart.h>
#include <zephyr/kernel.h>
#include <zephyr/logging/log.h>
#include <zephyr/pm/device.h>

#include "button.h"
#include "codec.h"
#include "config.h"
#include "device_id.h"
#include "led.h"
#include "mic.h"
#include "sdcard.h"
#include "speaker.h"
#include "storage.h"
#include "transport.h"
#include "usb.h"
#include "utils.h"
#include "wdog_facade.h"
#ifdef CONFIG_BOOTLOADER_MCUBOOT
#include <zephyr/dfu/mcuboot.h>
#endif
#define BOOT_BLINK_DURATION_MS 600
#define BOOT_PAUSE_DURATION_MS 200
#define VBUS_DETECT (1U << 20)
#define WAKEUP_DETECT (1U << 16)
LOG_MODULE_REGISTER(main, CONFIG_LOG_DEFAULT_LEVEL);

static void codec_handler(uint8_t *data, size_t len)
{
    int err = broadcast_audio_packets(data, len);
    if (err) {
        LOG_ERR("Failed to broadcast audio packets: %d", err);
    }
}

static void mic_handler(int16_t *buffer)
{
    int err = codec_receive_pcm(buffer, MIC_BUFFER_SAMPLES);
    if (err) {
        LOG_ERR("Failed to process PCM data: %d", err);
    }
}

void bt_ctlr_assert_handle(char *name, int type)
{
    LOG_INF("Bluetooth assert: %s (type %d)", name ? name : "NULL", type);
}

static void print_reset_reason(void)
{
    uint32_t reas = NRF_POWER->RESETREAS;

    // Clear the reset reason register
    NRF_POWER->RESETREAS = reas;

    if (reas & POWER_RESETREAS_DOG_Msk) {
        printk("Reset by WATCHDOG\n");
    } else if (reas & POWER_RESETREAS_NFC_Msk) {
        printk("Wake up by NFC field detect\n");
    } else if (reas & POWER_RESETREAS_RESETPIN_Msk) {
        printk("Reset by pin-reset\n");
    } else if (reas & POWER_RESETREAS_SREQ_Msk) {
        printk("Reset by soft-reset\n");
    } else if (reas & POWER_RESETREAS_LOCKUP_Msk) {
        printk("Reset by CPU LOCKUP\n");
    } else if (reas) {
        printk("Reset by a different source (0x%08X)\n", reas);
    } else {
        printk("Power-on-reset\n");
    }
}

bool is_connected = false;
bool is_charging = false;
extern bool is_off;
extern bool usb_charge;
extern volatile bool recording_active;
static void boot_led_sequence(void)
{
    // Red blink
    set_led_red(true);
    k_msleep(BOOT_BLINK_DURATION_MS);
    set_led_red(false);
    k_msleep(BOOT_PAUSE_DURATION_MS);
    // Green blink
    set_led_green(true);
    k_msleep(BOOT_BLINK_DURATION_MS);
    set_led_green(false);
    k_msleep(BOOT_PAUSE_DURATION_MS);
    // Blue blink
    set_led_blue(true);
    k_msleep(BOOT_BLINK_DURATION_MS);
    set_led_blue(false);
    k_msleep(BOOT_PAUSE_DURATION_MS);
    // All LEDs on
    set_led_red(true);
    set_led_green(true);
    set_led_blue(true);
    k_msleep(BOOT_BLINK_DURATION_MS);
    // All LEDs off
    set_led_red(false);
    set_led_green(false);
    set_led_blue(false);
}

void set_led_state()
{
    // Recording and connected state - BLUE

    if (usb_charge) {
        is_charging = !is_charging;
        if (is_charging) {
            set_led_green(true);
        } else {
            set_led_green(false);
        }
    } else {
        set_led_green(false);
    }
    if (is_off) {
        set_led_red(false);
        set_led_blue(false);
        return;
    }
    // Recording — GREEN
    if (recording_active) {
        set_led_green(true);
        set_led_red(false);
        set_led_blue(false);
        return;
    }

    if (is_connected) {
        set_led_blue(true);
        set_led_red(false);
        return;
    }

    // Not connected — RED slow blink (1s on, 1s off)
    if (!is_connected) {
        bool blink = (k_uptime_get() / 1000) % 2 == 0;
        set_led_red(blink);
        set_led_blue(false);
        return;
    }
}

int main(void)
{
    int err;

    // Print and clear reset reason
    print_reset_reason();

    NRF_POWER->DCDCEN = 1;
    NRF_POWER->DCDCEN0 = 1;

    LOG_INF("Booting...\n");

    LOG_INF("Model: %s", CONFIG_BT_DIS_MODEL);
    LOG_INF("Firmware revision: %s", CONFIG_BT_DIS_FW_REV_STR);
    LOG_INF("Hardware revision: %s", CONFIG_BT_DIS_HW_REV_STR);
    // QSPI flash is used by MCUboot for secondary slot (OTA updates).
    // MCUmgr SMP writes new firmware images there.
    // Do NOT suspend QSPI flash — it must remain accessible for OTA.
    LOG_PRINTK("\n");
    LOG_INF("Initializing LEDs...\n");

    err = led_start();
    if (err) {
        LOG_ERR("Failed to initialize LEDs (err %d)", err);
        return err;
    }

    // Run the boot LED sequence
    boot_led_sequence();

    // Initialize watchdog early to catch any freezes during boot
    err = watchdog_init();
    if (err) {
        LOG_WRN("Watchdog init failed (err %d), continuing without watchdog", err);
    }

    // Enable battery
#ifdef CONFIG_OMI_ENABLE_BATTERY
    err = battery_init();
    if (err) {
        LOG_ERR("Battery init failed (err %d)", err);
        return err;
    }

    err = battery_charge_start();
    if (err) {
        LOG_ERR("Battery failed to start (err %d)", err);
        return err;
    }
    LOG_INF("Battery initialized");
#endif

    // Enable speaker FIRST (before button, so logs are visible)
    printk("\n=== SPEAKER INIT ===\n");
#ifdef CONFIG_OMI_ENABLE_SPEAKER
    err = speaker_init();
    if (err) {
        printk("[speaker] FAILED err=%d\n", err);
    } else {
        printk("[speaker] OK\n");
    }
#endif

    // Enable button
#ifdef CONFIG_OMI_ENABLE_BUTTON
    err = button_init();
    if (err) {
        LOG_ERR("Failed to initialize Button (err %d)", err);
        return err;
    }
    LOG_INF("Button initialized");
    activate_button_work();
    LOG_INF("Button work queue activated (D4=power, D5=input)");
#endif

    // Enable accelerometer
#ifdef CONFIG_OMI_ENABLE_ACCELEROMETER
    err = accel_start();
    if (err) {
        LOG_ERR("Accelerometer failed to activated (err %d)", err);
        return err;
    }
    LOG_INF("Accelerometer initialized");
#endif

    // Enable sdcard
#ifdef CONFIG_OMI_ENABLE_OFFLINE_STORAGE
    LOG_PRINTK("\n");
    LOG_INF("Mount SD card...\n");

    err = mount_sd_card();
    if (err) {
        LOG_ERR("Failed to mount SD card (err %d) — continuing without SD", err);
    }
    k_msleep(500);

    LOG_PRINTK("\n");
    LOG_INF("Initializing storage...\n");

    if (!err) {
        err = storage_init();
        if (err) {
            LOG_ERR("Failed to initialize storage (err %d) — continuing without storage", err);
        }
    } else {
        LOG_WRN("Skipping storage init (no SD card)");
    }
#endif

    // Haptic feedback is now via speaker (no motor).
    // init_haptic_pin() is a no-op but kept for BLE service compatibility.
    init_haptic_pin();

    // Enable usb
#ifdef CONFIG_OMI_ENABLE_USB
    LOG_PRINTK("\n");
    LOG_INF("Initializing power supply check...\n");

    err = init_usb();
    if (err) {
        LOG_ERR("Failed to initialize power supply (err %d)", err);
        return err;
    }
#endif

    // Initialize device ID from NVS (must be before transport_start)
    err = device_id_init();
    if (err) {
        LOG_WRN("Device ID init failed (err %d), using default name", err);
    }

    // Device ID serial listener moved to main loop (serial_id_poll)

    // Indicate transport initialization
    LOG_PRINTK("\n");
    LOG_INF("Initializing transport...\n");

    set_led_green(true);
    set_led_green(false);

    // Start transport
    int transportErr;
    transportErr = transport_start();
    if (transportErr) {
        LOG_ERR("Failed to start transport (err %d)", transportErr);
        // TODO: Detect the current core is app core or net core
        // Blink green LED to indicate error
        for (int i = 0; i < 5; i++) {
            set_led_green(!gpio_pin_get_dt(&led_green));
            k_msleep(200);
        }
        set_led_green(false);

        return transportErr;
    }

#ifdef CONFIG_OMI_ENABLE_SPEAKER
    play_boot_sound();
#endif

    LOG_PRINTK("\n");
    LOG_INF("Initializing codec...\n");

    set_led_blue(true);

    // Audio codec(opus) callback
    set_codec_callback(codec_handler);
    err = codec_start();
    if (err) {
        LOG_ERR("Failed to start codec: %d", err);
        // Blink blue LED to indicate error
        for (int i = 0; i < 5; i++) {
            set_led_blue(!gpio_pin_get_dt(&led_blue));
            k_msleep(200);
        }
        set_led_blue(false);
        return err;
    }

    // Boot haptic buzz via speaker (500ms low-freq rumble)
    play_haptic_milli(500);
    set_led_blue(false);

    // Indicate microphone initialization
    LOG_PRINTK("\n");
    LOG_INF("Initializing microphone...\n");

    set_led_red(true);
    set_led_green(true);

    set_mic_callback(mic_handler);
    err = mic_start();
    if (err) {
        LOG_ERR("Failed to start microphone: %d", err);
        // Blink red and green LEDs to indicate error
        for (int i = 0; i < 5; i++) {
            set_led_red(!gpio_pin_get_dt(&led_red));
            set_led_green(!gpio_pin_get_dt(&led_green));
            k_msleep(200);
        }
        set_led_red(false);
        set_led_green(false);
        return err;
    }

    set_led_red(false);
    set_led_green(false);

    // Indicate successful initialization
    LOG_PRINTK("\n");
    LOG_INF("Device initialized successfully\n");

    set_led_blue(true);
    k_msleep(1000);
    set_led_blue(false);

    // MCUboot: confirm this firmware image is working.
    // If we reach here, all critical subsystems (BLE, codec, mic) initialized OK.
    // Without confirmation, MCUboot will revert to the previous image on next reboot.
#ifdef CONFIG_BOOTLOADER_MCUBOOT
    if (!boot_is_img_confirmed()) {
        int confirm_err = boot_write_img_confirmed();
        if (confirm_err) {
            LOG_ERR("Failed to confirm firmware image: %d", confirm_err);
        } else {
            LOG_INF("Firmware image confirmed as working");
        }
    }
#endif

    // Main loop
    LOG_PRINTK("\n");
    LOG_INF("Entering main loop...\n");

    // Serial ID listener: accepts "PINCLAW_ID=XXX\r\n" at any time
    const struct device *uart_dev = DEVICE_DT_GET(DT_CHOSEN(zephyr_console));
    static uint8_t serial_cmd_buf[32];
    static int serial_cmd_pos = 0;

    // Main loop: watchdog + LED state + serial ID listener.
    // Button: D4 (P0.04) = output 3.3V power, D5 (P0.05) = input read.
    // PTT logic in button.c via work queue (activate_button_work above).
    while (1) {
        watchdog_feed();
        set_led_state();

        // Non-blocking serial poll for device ID command
        if (device_is_ready(uart_dev)) {
            uint8_t c;
            while (uart_poll_in(uart_dev, &c) == 0) {
                if (c == '\n' || c == '\r') {
                    serial_cmd_buf[serial_cmd_pos] = '\0';
                    if (serial_cmd_pos > 11 &&
                        strncmp((char *)serial_cmd_buf, "PINCLAW_ID=", 11) == 0) {
                        int num = atoi((char *)serial_cmd_buf + 11);
                        if (num > 0 && num <= 999) {
                            device_id_set((uint16_t)num);
                            printk("OK DEVICE_ID=%d NAME=%s\n",
                                   num, device_id_get_name());
                        }
                    }
                    serial_cmd_pos = 0;
                } else if (serial_cmd_pos < (int)sizeof(serial_cmd_buf) - 1) {
                    serial_cmd_buf[serial_cmd_pos++] = c;
                }
            }
        }

        k_msleep(20);
    }

    // Unreachable
    return 0;
}
```

## src/button.c
```c
#include "button.h"

#include <zephyr/bluetooth/bluetooth.h>
#include <zephyr/bluetooth/gatt.h>
#include <zephyr/bluetooth/l2cap.h>
#include <zephyr/bluetooth/services/bas.h>
#include <zephyr/bluetooth/uuid.h>
#include <zephyr/drivers/gpio.h>
#include <zephyr/kernel.h>
#include <zephyr/logging/log.h>
#include <zephyr/sys/poweroff.h>
#include <hal/nrf_gpio.h>

#include "led.h"
#include "mic.h"
#include "speaker.h"
#include "transport.h"
#include "wdog_facade.h"
LOG_MODULE_REGISTER(button, CONFIG_LOG_DEFAULT_LEVEL);

bool is_off = false;
static void button_ccc_config_changed_handler(const struct bt_gatt_attr *attr, uint16_t value);
static ssize_t button_data_read_characteristic(struct bt_conn *conn,
                                               const struct bt_gatt_attr *attr,
                                               void *buf,
                                               uint16_t len,
                                               uint16_t offset);
static struct gpio_callback button_cb_data;

static struct bt_uuid_128 button_uuid =
    BT_UUID_INIT_128(BT_UUID_128_ENCODE(0x23BA7924, 0x0000, 0x1000, 0x7450, 0x346EAC492E92));
static struct bt_uuid_128 button_characteristic_data_uuid =
    BT_UUID_INIT_128(BT_UUID_128_ENCODE(0x23BA7925, 0x0000, 0x1000, 0x7450, 0x346EAC492E92));

static struct bt_gatt_attr button_service_attr[] = {
    BT_GATT_PRIMARY_SERVICE(&button_uuid),
    BT_GATT_CHARACTERISTIC(&button_characteristic_data_uuid.uuid,
                           BT_GATT_CHRC_READ | BT_GATT_CHRC_NOTIFY,
                           BT_GATT_PERM_READ,
                           button_data_read_characteristic,
                           NULL,
                           NULL),
    BT_GATT_CCC(button_ccc_config_changed_handler, BT_GATT_PERM_READ | BT_GATT_PERM_WRITE),
};

static struct bt_gatt_service button_service = BT_GATT_SERVICE(button_service_attr);

static void button_ccc_config_changed_handler(const struct bt_gatt_attr *attr, uint16_t value)
{
    if (value == BT_GATT_CCC_NOTIFY) {
        LOG_INF("Client subscribed for notifications");
    } else if (value == 0) {
        LOG_INF("Client unsubscribed from notifications");
    } else {
        LOG_ERR("Invalid CCC value: %u", value);
    }
}

// Pinclaw PTT button: D4 (P0.04) = input with pull-up, switch to GND
// Pressed: D4 pulled LOW by switch → reads 0
// Released: D4 pulled HIGH by internal pull-up → reads 1
struct gpio_dt_spec d4_pin_input = {.port = DEVICE_DT_GET(DT_NODELABEL(gpio0)),
                                    .pin = 4,
                                    .dt_flags = 0};

#define BUTTON_CHECK_INTERVAL 40 // 0.04 seconds, 25 Hz

void check_button_level(struct k_work *work_item);
K_WORK_DELAYABLE_DEFINE(button_work, check_button_level);

#define SINGLE_TAP 1
#define DOUBLE_TAP 2
#define LONG_TAP 3
#define BUTTON_PRESS 4
#define BUTTON_RELEASE 5

static FSM_STATE_T current_button_state = IDLE;

static int final_button_state[2] = {0, 0};

static inline void notify_press()
{
    final_button_state[0] = BUTTON_PRESS;
    LOG_INF("Button pressed");
    struct bt_conn *conn = get_current_connection();
    if (conn != NULL) {
        bt_gatt_notify(conn, &button_service.attrs[1], &final_button_state, sizeof(final_button_state));
    }
}

static inline void notify_unpress()
{
    final_button_state[0] = BUTTON_RELEASE;
    LOG_INF("Button released");
    struct bt_conn *conn = get_current_connection();
    if (conn != NULL) {
        bt_gatt_notify(conn, &button_service.attrs[1], &final_button_state, sizeof(final_button_state));
    }
}

// Pinclaw PTT: press immediately starts mic capture + green LED.
// Hold >= 0.5s: confirmed recording (START sent to iOS, audio flows).
// Release < 0.5s: discard buffered audio, send PLAY command instead.
void check_button_level(struct k_work *work_item)
{
    // Poll D4: active LOW (pressed = 0 when switch connects to GND)
    int raw = gpio_pin_get_raw(d4_pin_input.port, d4_pin_input.pin);
    bool pressed = (raw == 0);

    // Debug: print D4 value every 2 seconds
    static int debug_counter = 0;
    if (++debug_counter >= 50) {  // 50 * 40ms = 2s
        LOG_INF("[BTN-DBG] D4 raw=%d pressed=%d", raw, pressed);
        debug_counter = 0;
    }

    static bool was_btn_pressed = false;
    static bool btn_confirmed = false;  // true after 500ms hold
    static int64_t press_start_time = 0;

    extern volatile bool recording_active;
    extern volatile bool recording_confirmed;
    extern uint16_t opus_seq_no;
    extern struct bt_gatt_service audio_service;

    // Button just pressed — immediately start mic capture + green LED
    if (pressed && !was_btn_pressed) {
        was_btn_pressed = true;
        btn_confirmed = false;
        press_start_time = k_uptime_get();
        // Stop any ongoing speaker playback
        speaker_stop();
        // Start capturing immediately (mic + opus encode into ring buffer)
        recording_active = true;
        recording_confirmed = false;  // gate: pusher won't send yet
        opus_seq_no = 0;
        set_led_red(true);  // green LED on — immediate user feedback
        LOG_INF("[BTN] Press — mic started, awaiting 500ms confirm");
    }

    // Button held past 0.5s — confirm recording, send START to iOS
    if (pressed && was_btn_pressed && !btn_confirmed) {
        int64_t held = k_uptime_get() - press_start_time;
        if (held >= 500) {
            btn_confirmed = true;
            recording_confirmed = true;  // ungate pusher — buffered frames flow
            struct bt_conn *conn = get_current_connection();
            if (conn) {
                uint8_t start_pkt[6] = {0x01, 0x14, 0x00, 0x00, 0x00, 0x00};
                bt_gatt_notify(conn, &audio_service.attrs[1], start_pkt, 6);
            }
            LOG_INF("[BTN] Recording confirmed (held >= 500ms)");
        }
    }

    // Button released
    if (!pressed && was_btn_pressed) {
        was_btn_pressed = false;
        int64_t duration = k_uptime_get() - press_start_time;

        if (btn_confirmed) {
            // Confirmed recording — normal stop, enqueue END
            recording_active = false;
            btn_confirmed = false;
            enqueue_end_packet(opus_seq_no);
            // DON'T set recording_confirmed = false here!
            // Pusher needs it true to send remaining frames + END packet.
            // Pusher will clear it after the ring buffer drains.
            set_led_red(false);
            LOG_INF("[BTN] Recording stopped, frames=%d", opus_seq_no);
        } else {
            // Short tap (< 0.5s) — discard buffered audio, send PLAY
            recording_active = false;
            recording_confirmed = false;
            btn_confirmed = false;
            flush_audio_queue();  // discard any buffered frames
            set_led_red(false);
            LOG_INF("[BTN] Short tap (%lld ms) — discarded, PLAY", duration);
            struct bt_conn *conn = get_current_connection();
            if (conn) {
                uint8_t play_cmd = 0x20;
                bt_gatt_notify(conn, &audio_service.attrs[3], &play_cmd, 1);
            }
        }
    }

    k_work_reschedule(&button_work, K_MSEC(BUTTON_CHECK_INTERVAL));
}

static ssize_t button_data_read_characteristic(struct bt_conn *conn,
                                               const struct bt_gatt_attr *attr,
                                               void *buf,
                                               uint16_t len,
                                               uint16_t offset)
{
    return bt_gatt_attr_read(conn, attr, buf, len, offset, &final_button_state, sizeof(final_button_state));
}

int button_init()
{
    // XIAO BLE Sense has on-board IMU (LSM6DS3TR-C) wired to P0.04 (I2C1 SDA)
    // and P0.05 (I2C1 SCL). With CONFIG_I2C=n the driver never runs, so the
    // TWIM1 peripheral may still hold these pins. Force-disconnect before use.
    volatile uint32_t *twi1_enable = (volatile uint32_t *)(0x40004000 + 0x500);
    volatile uint32_t *twi1_scl = (volatile uint32_t *)(0x40004000 + 0x504);
    volatile uint32_t *twi1_sda = (volatile uint32_t *)(0x40004000 + 0x508);
    LOG_INF("TWIM1 before fix: EN=%d SDA=0x%08x SCL=0x%08x",
            *twi1_enable, *twi1_sda, *twi1_scl);
    *twi1_enable = 0;
    *twi1_sda = 0x80000000;  // disconnect
    *twi1_scl = 0x80000000;  // disconnect
    LOG_INF("TWIM1 disconnected from P0.04/P0.05");

    // Also check TWIM0 for P0.04 (SDA)
    volatile uint32_t *twi0_sda = (volatile uint32_t *)(0x40003000 + 0x508);
    if ((*twi0_sda & 0x1F) == 4 && !(*twi0_sda & 0x80000000)) {
        *twi0_sda = 0x80000000;
        LOG_INF("TWIM0 SDA was on P0.04, disconnected");
    }

    // D4 (P0.04): input with pull-up, switch connects to GND
    if (!gpio_is_ready_dt(&d4_pin_input)) {
        LOG_ERR("D4 pin not ready");
        return -1;
    }
    int err = gpio_pin_configure_dt(&d4_pin_input, GPIO_INPUT | GPIO_PULL_UP);
    if (err) {
        LOG_ERR("D4 input config failed: %d", err);
        return -1;
    }
    LOG_INF("D4 configured as input with pull-up");

    // Interrupt on both edges for responsive detection
    err = gpio_pin_interrupt_configure(d4_pin_input.port, d4_pin_input.pin, GPIO_INT_EDGE_BOTH);
    if (err) {
        LOG_ERR("D4 interrupt config failed: %d", err);
        return -1;
    }

    // Read initial state
    int d4_val = gpio_pin_get_raw(d4_pin_input.port, d4_pin_input.pin);
    LOG_INF("D4 initial value: %d (should be 1 if not pressed)", d4_val);

    return 0;
}

void activate_button_work()
{
    k_work_schedule(&button_work, K_MSEC(BUTTON_CHECK_INTERVAL));
}

void register_button_service()
{
    bt_gatt_service_register(&button_service);
}

FSM_STATE_T get_current_button_state()
{
    return current_button_state;
}

void turnoff_all()
{
    mic_off();
    accel_off();
    play_haptic_milli(50);
    speaker_off();
    k_msleep(100);
    set_led_blue(false);
    set_led_red(false);
    set_led_green(false);
    gpio_pin_interrupt_configure(d4_pin_input.port, d4_pin_input.pin, GPIO_INT_DISABLE);

    // Disable watchdog before entering system off
    int rc = watchdog_deinit();
    if (rc < 0) {
        LOG_ERR("Failed to deinitialize watchdog (%d)", rc);
    }

    NRF_USBD->INTENCLR = 0xFFFFFFFF;

    // Configure D4 (P0.04) as SENSE LOW wake-up source
    // so pressing the button powers the device back on from System OFF.
    // Use nrf_gpio_cfg_sense_input to fully reconfigure the pin (input + pull-up + SENSE)
    // because gpio_pin_interrupt_configure(GPIO_INT_DISABLE) above clears SENSE bits.
    nrf_gpio_cfg_sense_input(NRF_GPIO_PIN_MAP(0, 4),
                             NRF_GPIO_PIN_PULLUP,
                             NRF_GPIO_PIN_SENSE_LOW);

    NRF_POWER->SYSTEMOFF = 1;
}

void force_button_state(FSM_STATE_T state)
{
    current_button_state = state;
}
```

## src/device_id.c
```c
#include "device_id.h"

#include <nrfx.h>
#include <stdio.h>
#include <string.h>
#include <zephyr/bluetooth/bluetooth.h>
#include <zephyr/drivers/flash.h>
#include <zephyr/fs/nvs.h>
#include <zephyr/kernel.h>
#include <zephyr/logging/log.h>
#include <zephyr/storage/flash_map.h>

LOG_MODULE_REGISTER(device_id, CONFIG_LOG_DEFAULT_LEVEL);

#define NVS_DEVICE_ID_KEY 1
#define BLE_NAME_MAX_LEN  20

static struct nvs_fs nvs;
static char ble_name[BLE_NAME_MAX_LEN];
static uint8_t ble_name_len;
static uint16_t device_number;
static char hardware_id[17]; // 16 hex chars + null

static void build_name(uint16_t num)
{
    device_number = num;
    if (num > 0 && num <= 999) {
        ble_name_len = snprintf(ble_name, sizeof(ble_name), "Pinclaw %03d", num);
    } else {
        ble_name_len = snprintf(ble_name, sizeof(ble_name), "Pinclaw");
    }
}

int device_id_init(void)
{
    const struct flash_area *fa;
    int rc = flash_area_open(FIXED_PARTITION_ID(storage_partition), &fa);
    if (rc) {
        LOG_ERR("Flash area open failed: %d", rc);
        build_name(0);
        return rc;
    }

    nvs.flash_device = fa->fa_dev;
    nvs.offset = fa->fa_off;
    nvs.sector_size = 4096;  // nRF52840 flash page size
    nvs.sector_count = 2;    // 8KB for NVS (plenty for device ID)
    flash_area_close(fa);

    rc = nvs_mount(&nvs);
    if (rc) {
        LOG_ERR("NVS mount failed: %d", rc);
        build_name(0);
        return rc;
    }
    LOG_INF("NVS mounted");

    // Read chip-unique FICR DEVICEID (factory-programmed, immutable)
    snprintf(hardware_id, sizeof(hardware_id), "%08X%08X",
             NRF_FICR->DEVICEID[1], NRF_FICR->DEVICEID[0]);
    LOG_INF("Hardware ID: %s", hardware_id);

    // Read stored device number
    uint16_t stored = 0;
    rc = nvs_read(&nvs, NVS_DEVICE_ID_KEY, &stored, sizeof(stored));
    if (rc > 0) {
        build_name(stored);
        LOG_INF("Device ID loaded: %d → \"%s\"", stored, ble_name);
    } else {
        build_name(0);
        LOG_INF("No device ID stored, using default name \"%s\"", ble_name);
    }

    return 0;
}

const char *device_id_get_name(void)
{
    return ble_name;
}

uint8_t device_id_get_name_len(void)
{
    return ble_name_len;
}

uint16_t device_id_get_number(void)
{
    return device_number;
}

const char *device_id_get_hardware_id(void)
{
    return hardware_id;
}

int device_id_set(uint16_t number)
{
    int rc = nvs_write(&nvs, NVS_DEVICE_ID_KEY, &number, sizeof(number));
    if (rc < 0) {
        LOG_ERR("NVS write failed: %d", rc);
        return rc;
    }

    build_name(number);
    // Update BLE name immediately so scanners see the new name
    bt_set_name(ble_name);
    LOG_INF("Device ID set: %d → \"%s\"", number, ble_name);
    return 0;
}
```

## src/device_id.h
```c
#ifndef DEVICE_ID_H
#define DEVICE_ID_H

#include <stdint.h>

/**
 * Initialize device ID from NVS.
 * Must be called before transport_start().
 */
int device_id_init(void);

/**
 * Get the BLE device name (e.g. "Pinclaw 010").
 * Returns pointer to static buffer, valid until next set call.
 */
const char *device_id_get_name(void);

/**
 * Get the name length.
 */
uint8_t device_id_get_name_len(void);

/**
 * Set device number (0-999) and persist to NVS.
 * Updates the BLE name immediately.
 * Returns 0 on success.
 */
int device_id_set(uint16_t number);

/**
 * Get the raw device number (0 if not set).
 */
uint16_t device_id_get_number(void);

/**
 * Get the 16-char hex hardware ID derived from FICR DEVICEID.
 * Example: "A1B2C3D4E5F60718"
 * Returns pointer to static buffer, always valid after device_id_init().
 */
const char *device_id_get_hardware_id(void);

#endif
```

## src/transport.h
```c
#ifndef TRANSPORT_H
#define TRANSPORT_H

#include <stdint.h>
#include <stddef.h>
#include <zephyr/drivers/sensor.h>
typedef struct sensors {

    struct sensor_value a_x;
    struct sensor_value a_y;
    struct sensor_value a_z;
    struct sensor_value g_x;
    struct sensor_value g_y;
    struct sensor_value g_z;
};
/**
 * @brief Initialize the BLE transport logic
 *
 * Initializes the BLE Logic
 *
 * @return 0 if successful, negative errno code if error
 */
int transport_start();
int broadcast_audio_packets(uint8_t *buffer, size_t size);
int enqueue_end_packet(uint16_t total_frames);
void flush_audio_queue(void);
struct bt_conn *get_current_connection();
int bt_on();
int bt_off();

void accel_off();
#endif
```
