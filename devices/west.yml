## devices/west.yml
```yaml
manifest:
  version: "1.2"
  remotes:
    - name: zephyrproject-rtos
      url-base: https://github.com/zephyrproject-rtos
  projects:
    - name: zephyr
      remote: zephyrproject-rtos
      revision: v4.3.0
      import:
        name-allowlist:
          - cmsis
          - cmsis_6
          - hal_espressif
          - hal_nordic
          - mbedtls
          - mcuboot
          - picolibc
          - tinycrypt
  self:
    path: nexting-devices
```
