## CMakeLists.txt
```
# SPDX-License-Identifier: Apache-2.0
set(BOARD seeed_xiao_nrf52840_sense)
cmake_minimum_required(VERSION 3.20.0)
find_package(Zephyr REQUIRED HINTS $ENV{ZEPHYR_BASE})
project(nrf52840_nordic)
enable_language(C ASM)

target_sources(app PRIVATE
    src/main.c
    src/transport.c
    src/mic.c
    src/led.c
    src/codec.c
    src/lib/battery/battery.c
    src/button.c
    src/speaker.c
    src/usb.c
    src/device_id.c
    src/storage_stub.c
    src/wdog_facade.c
	# src/nfc.c future release
)

target_sources_ifdef(CONFIG_OMI_CODEC_OPUS app PRIVATE
    src/lib/opus-1.2.1/A2NLSF.c
    src/lib/opus-1.2.1/CNG.c
    src/lib/opus-1.2.1/HP_variable_cutoff.c
    src/lib/opus-1.2.1/LPC_analysis_filter.c
    src/lib/opus-1.2.1/LPC_fit.c
    src/lib/opus-1.2.1/LPC_inv_pred_gain.c
    src/lib/opus-1.2.1/LP_variable_cutoff.c
    src/lib/opus-1.2.1/LTP_analysis_filter_FIX.c
    src/lib/opus-1.2.1/LTP_scale_ctrl_FIX.c
    src/lib/opus-1.2.1/NLSF2A.c
    src/lib/opus-1.2.1/NLSF_VQ.c
    src/lib/opus-1.2.1/NLSF_VQ_weights_laroia.c
    src/lib/opus-1.2.1/NLSF_decode.c
    src/lib/opus-1.2.1/NLSF_del_dec_quant.c
    src/lib/opus-1.2.1/NLSF_encode.c
    src/lib/opus-1.2.1/NLSF_stabilize.c
    src/lib/opus-1.2.1/NLSF_unpack.c
    src/lib/opus-1.2.1/NSQ.c
    src/lib/opus-1.2.1/NSQ_del_dec.c
    src/lib/opus-1.2.1/PLC.c
    src/lib/opus-1.2.1/VAD.c
    src/lib/opus-1.2.1/VQ_WMat_EC.c
    src/lib/opus-1.2.1/ana_filt_bank_1.c
    src/lib/opus-1.2.1/analysis.c
    src/lib/opus-1.2.1/apply_sine_window_FIX.c
    src/lib/opus-1.2.1/autocorr_FIX.c
    src/lib/opus-1.2.1/bands.c
    src/lib/opus-1.2.1/biquad_alt.c
    src/lib/opus-1.2.1/burg_modified_FIX.c
    src/lib/opus-1.2.1/bwexpander.c
    src/lib/opus-1.2.1/bwexpander_32.c
    src/lib/opus-1.2.1/celt.c
    src/lib/opus-1.2.1/celt_decoder.c
    src/lib/opus-1.2.1/celt_encoder.c
    src/lib/opus-1.2.1/celt_lpc.c
    src/lib/opus-1.2.1/arm/celt_pitch_xcorr_arm_gcc.s
    src/lib/opus-1.2.1/check_control_input.c
    src/lib/opus-1.2.1/code_signs.c
    src/lib/opus-1.2.1/control_SNR.c
    src/lib/opus-1.2.1/control_audio_bandwidth.c
    src/lib/opus-1.2.1/control_codec.c
    src/lib/opus-1.2.1/corrMatrix_FIX.c
    src/lib/opus-1.2.1/cwrs.c
    src/lib/opus-1.2.1/debug.c
    src/lib/opus-1.2.1/dec_API.c
    src/lib/opus-1.2.1/decode_core.c
    src/lib/opus-1.2.1/decode_frame.c
    src/lib/opus-1.2.1/decode_indices.c
    src/lib/opus-1.2.1/decode_parameters.c
    src/lib/opus-1.2.1/decode_pitch.c
    src/lib/opus-1.2.1/decode_pulses.c
    src/lib/opus-1.2.1/decoder_set_fs.c
    src/lib/opus-1.2.1/enc_API.c
    src/lib/opus-1.2.1/encode_frame_FIX.c
    src/lib/opus-1.2.1/encode_indices.c
    src/lib/opus-1.2.1/encode_pulses.c
    src/lib/opus-1.2.1/entcode.c
    src/lib/opus-1.2.1/entdec.c
    src/lib/opus-1.2.1/entenc.c
    src/lib/opus-1.2.1/find_LPC_FIX.c
    src/lib/opus-1.2.1/find_LTP_FIX.c
    src/lib/opus-1.2.1/find_pitch_lags_FIX.c
    src/lib/opus-1.2.1/find_pred_coefs_FIX.c
    src/lib/opus-1.2.1/gain_quant.c
    src/lib/opus-1.2.1/init_decoder.c
    src/lib/opus-1.2.1/init_encoder.c
    src/lib/opus-1.2.1/inner_prod_aligned.c
    src/lib/opus-1.2.1/interpolate.c
    src/lib/opus-1.2.1/k2a_FIX.c
    src/lib/opus-1.2.1/k2a_Q16_FIX.c
    src/lib/opus-1.2.1/kiss_fft.c
    src/lib/opus-1.2.1/laplace.c
    src/lib/opus-1.2.1/lin2log.c
    src/lib/opus-1.2.1/log2lin.c
    src/lib/opus-1.2.1/mathops.c
    src/lib/opus-1.2.1/mdct.c
    src/lib/opus-1.2.1/mlp.c
    src/lib/opus-1.2.1/mlp_data.c
    src/lib/opus-1.2.1/modes.c
    src/lib/opus-1.2.1/noise_shape_analysis_FIX.c
    src/lib/opus-1.2.1/opus.c
    src/lib/opus-1.2.1/opus_decoder.c
    src/lib/opus-1.2.1/opus_encoder.c
    src/lib/opus-1.2.1/opus_multistream.c
    src/lib/opus-1.2.1/opus_multistream_decoder.c
    src/lib/opus-1.2.1/opus_multistream_encoder.c
    src/lib/opus-1.2.1/pitch.c
    src/lib/opus-1.2.1/pitch_analysis_core_FIX.c
    src/lib/opus-1.2.1/pitch_est_tables.c
    src/lib/opus-1.2.1/process_NLSFs.c
    src/lib/opus-1.2.1/process_gains_FIX.c
    src/lib/opus-1.2.1/quant_LTP_gains.c
    src/lib/opus-1.2.1/quant_bands.c
    src/lib/opus-1.2.1/rate.c
    src/lib/opus-1.2.1/regularize_correlations_FIX.c
    src/lib/opus-1.2.1/repacketizer.c
    src/lib/opus-1.2.1/resampler.c
    src/lib/opus-1.2.1/resampler_down2.c
    src/lib/opus-1.2.1/resampler_down2_3.c
    src/lib/opus-1.2.1/resampler_private_AR2.c
    src/lib/opus-1.2.1/resampler_private_IIR_FIR.c
    src/lib/opus-1.2.1/resampler_private_down_FIR.c
    src/lib/opus-1.2.1/resampler_private_up2_HQ.c
    src/lib/opus-1.2.1/resampler_rom.c
    src/lib/opus-1.2.1/residual_energy16_FIX.c
    src/lib/opus-1.2.1/residual_energy_FIX.c
    src/lib/opus-1.2.1/schur64_FIX.c
    src/lib/opus-1.2.1/schur_FIX.c
    src/lib/opus-1.2.1/shell_coder.c
    src/lib/opus-1.2.1/sigm_Q15.c
    src/lib/opus-1.2.1/sort.c
    src/lib/opus-1.2.1/stereo_LR_to_MS.c
    src/lib/opus-1.2.1/stereo_MS_to_LR.c
    src/lib/opus-1.2.1/stereo_decode_pred.c
    src/lib/opus-1.2.1/stereo_encode_pred.c
    src/lib/opus-1.2.1/stereo_find_predictor.c
    src/lib/opus-1.2.1/stereo_quant_pred.c
    src/lib/opus-1.2.1/sum_sqr_shift.c
    src/lib/opus-1.2.1/table_LSF_cos.c
    src/lib/opus-1.2.1/tables_LTP.c
    src/lib/opus-1.2.1/tables_NLSF_CB_NB_MB.c
    src/lib/opus-1.2.1/tables_NLSF_CB_WB.c
    src/lib/opus-1.2.1/tables_gain.c
    src/lib/opus-1.2.1/tables_other.c
    src/lib/opus-1.2.1/tables_pitch_lag.c
    src/lib/opus-1.2.1/tables_pulses_per_block.c
    src/lib/opus-1.2.1/vector_ops_FIX.c
    src/lib/opus-1.2.1/vq.c
    src/lib/opus-1.2.1/warped_autocorrelation_FIX.c
    src/lib/opus-1.2.1/arm/celt_pitch_xcorr_arm_gcc.s
)

set(CMAKE_C_FLAGS "${CMAKE_C_FLAGS} -DARM_MATH_CM4")
# set(CMAKE_C_FLAGS "${CMAKE_C_FLAGS} -DVAR_ARRAYS")
set(CMAKE_C_FLAGS "${CMAKE_C_FLAGS} -DOPUS_ARM_ASM")
set(CMAKE_C_FLAGS "${CMAKE_C_FLAGS} -DOPUS_ARM_INLINE_ASM")
set(CMAKE_C_FLAGS "${CMAKE_C_FLAGS} -DOPUS_ARM_INLINE_EDSP")
set(CMAKE_C_FLAGS "${CMAKE_C_FLAGS} -DOPUS_ARM_INLINE_MEDIA")
set(CMAKE_C_FLAGS "${CMAKE_C_FLAGS} -DOPUS_ARM_MAY_HAVE_EDSP")
set(CMAKE_C_FLAGS "${CMAKE_C_FLAGS} -DOPUS_ARM_PRESUME_EDSP")
set(CMAKE_C_FLAGS "${CMAKE_C_FLAGS} -DOPUS_BUILD")
set(CMAKE_C_FLAGS "${CMAKE_C_FLAGS} -DUSE_ALLOCA")
set(CMAKE_C_FLAGS "${CMAKE_C_FLAGS} -DFIXED_POINT -DDISABLE_FLOAT_API")
set(CMAKE_C_FLAGS "${CMAKE_C_FLAGS} -DHAVE_CONFIG_H")
set(CMAKE_C_FLAGS "${CMAKE_C_FLAGS} -DHAVE_ALLOCA_H")
set(CMAKE_C_FLAGS "${CMAKE_C_FLAGS} -fsingle-precision-constant") # A lot of constants are written as doubles
set(CMAKE_C_FLAGS "${CMAKE_C_FLAGS} -DHAVE_LRINT -DHAVE_LRINTF")

target_compile_options(app PRIVATE -Wno-error -Wno-unused-function -Wno-unused-variable -Wno-unused-but-set-variable)
```

## prj.conf
```kconfig
#
# Hardware settings
#

CONFIG_GPIO=y
CONFIG_NRFX_PDM=y
CONFIG_FLASH=y
CONFIG_FLASH_MAP=y
CONFIG_FLASH_PAGE_LAYOUT=y
CONFIG_NVS=y
CONFIG_ADC=y

# To flash via dev board
#CONFIG_BUILD_OUTPUT_UF2=n
#CONFIG_USE_DT_CODE_PARTITION=n
# Watchdog Timer
CONFIG_WATCHDOG=y
CONFIG_WDT_DISABLE_AT_BOOT=n

#
# Bluetooth settings
#

CONFIG_BT=y
CONFIG_BT_PERIPHERAL=y
CONFIG_BT_DEVICE_NAME="Pinclaw"
# Actual BLE name is set dynamically from NVS (e.g. "Pinclaw 010")
# See device_id.c — use test-device.sh to program device number
CONFIG_BT_MAX_CONN=3
# CONFIG_BT_EXT_ADV_MAX_ADV_SET=2
CONFIG_BT_MAX_PAIRED=1
CONFIG_BT_DEVICE_APPEARANCE=22
CONFIG_BT_GATT_DYNAMIC_DB=y

#
# Max transmit power supported by nRF52840
#

CONFIG_BT_CTLR_TX_PWR_ANTENNA=8
CONFIG_BT_PHY_UPDATE=y

#
# Battery and Device Information services
#

CONFIG_BT_BAS=y
CONFIG_BT_DIS=y
CONFIG_BT_DIS_PNP=n
CONFIG_BT_DIS_MODEL="Pinclaw Clip"
CONFIG_BT_DIS_MANUF="Pinclaw"
CONFIG_BT_DIS_FW_REV=y
CONFIG_BT_DIS_HW_REV=y
CONFIG_BT_DIS_FW_REV_STR="2.1.8"
CONFIG_BT_DIS_HW_REV_STR="Seeed Xiao BLE Sense"

#
# Large BLE packets / BLE Buffers 
#
# CONFIG_BT_GATT_CLIENT=y
# CONFIG_BT_THROUGHPUT=y

CONFIG_BT_L2CAP_TX_MTU=498

CONFIG_BT_CTLR_DATA_LENGTH_MAX=251
CONFIG_BT_CTLR_PHY_2M=y
CONFIG_BT_CTLR_PHY_CODED=y
CONFIG_BT_CTLR_SDC_MAX_CONN_EVENT_LEN_DEFAULT=400000
CONFIG_BT_CONN_TX_MAX=20
CONFIG_BT_BUF_ACL_RX_SIZE=1024
CONFIG_BT_L2CAP_TX_BUF_COUNT=10
CONFIG_BT_BUF_ACL_TX_SIZE=2048
# CONFIG_BT_ATT_TX_COUNT=10
# CONFIG_BT_EXT_ADV=y
# CONFIG_BT_PER_ADV=y
# CONFIG_BT_OBSERVER=y
# CONFIG_BT_ATT_PREPARE_COUNT=2
CONFIG_BT_USER_DATA_LEN_UPDATE=y
CONFIG_BT_AUTO_DATA_LEN_UPDATE=y
CONFIG_BT_USER_PHY_UPDATE=y
CONFIG_BT_AUTO_PHY_UPDATE=y

CONFIG_FPU=y
# CONFIG_NORDIC_QSPI_NOR — enabled below in MCUboot section
# CONFIG_BOARD_ENABLE_DCDC=y
#

#
# Console
#
# Disable the lines to enable console log
CONFIG_CONSOLE=y
CONFIG_PRINTK=y

#
# Logs
#

# Enable the lines below to enable logs via UART/USB
CONFIG_LOG=y
CONFIG_LOG_PRINTK=y
CONFIG_UART_CONSOLE=y
# CONFIG_LOG_PROCESS_THREAD_PRIORITY=5
# CONFIG_LOG_PROCESS_THREAD_CUSTOM_PRIORITY=y

# Enable the lines below to enable debug logs
# Warn: Level 4 is the cause of crashing
CONFIG_LOG_DEFAULT_LEVEL=3

#
# Log level and buffer size
#

# CONFIG_LOG_OVERRIDE_LEVEL=4
# CONFIG_LOG_BUFFER_SIZE=32000
# CONFIG_LOG_PROCESS_THREAD_STACK_SIZE=4096

#
# Debug
#

# CONFIG_DEBUG=y
# CONFIG_DEBUG_OPTIMIZATIONS=y
# CONFIG_SERIAL=y

#
# Debug (This value breaks some builds)
#

# CONFIG_ASSERT=y

#
# BT log configuration
#

# CONFIG_BT_DEBUG_LOG=y
# CONFIG_BT_L2CAP_LOG_LEVEL_DBG=y
# CONFIG_BT_LOG_LEVEL_DBG=y

# CONFIG_BT_RX_STACK_SIZE=4096
# CONFIG_BT_CTLR_RX_PRIO_STACK_SIZE=4096
# CONFIG_BT_DEBUG_LOG=y
# CONFIG_BT_RX_STACK_SIZE=4096
# CONFIG_BT_CTLR_RX_PRIO_STACK_SIZE=4096

#
# SD Card Support (all devices required)
#

CONFIG_DISK_ACCESS=n
CONFIG_FILE_SYSTEM=n
CONFIG_FAT_FILESYSTEM_ELM=n
CONFIG_FS_FATFS_MOUNT_MKFS=n
CONFIG_FS_FATFS_EXFAT=n
#nessessary?
CONFIG_MAIN_STACK_SIZE=2048
# CONFIG_DISK_DRIVER_SDMMC=y
# CONFIG_SPI=y
CONFIG_HEAP_MEM_POOL_SIZE=4096

#
# Disable unused peripherals
#
CONFIG_I2C=n
# CONFIG_NRFX_TWIM0=n
# CONFIG_NRFX_TWIM1=n

#
# LSM6DSL sensor (accelerometer and gyroscope)
#
CONFIG_LSM6DSL=n
CONFIG_LSM6DSL_ENABLE_TEMP=n
# CONFIG_LSM6DSL_TRIGGER_GLOBAL_THREAD=y
CONFIG_SENSOR=n

#
# Speaker
#
CONFIG_I2S=y
CONFIG_I2S_NRFX=y
CONFIG_SPI=y
CONFIG_SPI_NRFX=y

#
# NFC (in the future)
#

# CONFIG_NFC_T2T_NRFXLIB=y
# CONFIG_NFC_NDEF=y
# CONFIG_NFC_NDEF_MSG=y
# CONFIG_NFC_NDEF_RECORD=y
# CONFIG_NFC_NDEF_URI_MSG=y
# CONFIG_NFC_NDEF_URI_REC=y
# CONFIG_HWINFO=y

#
#EVERYTHING ELSE
#

CONFIG_RING_BUFFER=y

CONFIG_PM_DEVICE=y
# CONFIG_NRFX_USBD=y

# CONFIG_FLASH=y

#
# Omi features configuration
#

CONFIG_OMI_CODEC_OPUS=y
CONFIG_OMI_ENABLE_OFFLINE_STORAGE=n
CONFIG_OMI_ENABLE_ACCELEROMETER=n
CONFIG_OMI_ENABLE_BUTTON=y
CONFIG_OMI_ENABLE_SPEAKER=y
CONFIG_OMI_ENABLE_BATTERY=y
CONFIG_OMI_ENABLE_USB=y
CONFIG_OMI_ENABLE_HAPTIC=n
CONFIG_SERIAL=y
CONFIG_BT_GATT_CLIENT=y

# OTA (MCUboot + MCUmgr) configs moved to prj_ota.conf
# Build with: west build ... -- -DOVERLAY_CONFIG=prj_ota.conf
```

## src/main.c
```c
#include <stdlib.h>
#include <string.h>
#include <zephyr/drivers/uart.h>
#include <zephyr/kernel.h>
#include <zephyr/logging/log.h>
#include <zephyr/pm/device.h>

#include "button.h"
#include "codec.h"
#include "config.h"
#include "device_id.h"
#include "led.h"
#include "mic.h"
#include "sdcard.h"
#include "speaker.h"
#include "storage.h"
#include "transport.h"
#include "usb.h"
#include "utils.h"
#include "wdog_facade.h"
#ifdef CONFIG_BOOTLOADER_MCUBOOT
#include <zephyr/dfu/mcuboot.h>
#endif
#define BOOT_BLINK_DURATION_MS 600
#define BOOT_PAUSE_DURATION_MS 200
#define VBUS_DETECT (1U << 20)
#define WAKEUP_DETECT (1U << 16)
LOG_MODULE_REGISTER(main, CONFIG_LOG_DEFAULT_LEVEL);

static void codec_handler(uint8_t *data, size_t len)
{
    int err = broadcast_audio_packets(data, len);
    if (err) {
        LOG_ERR("Failed to broadcast audio packets: %d", err);
    }
}

static void mic_handler(int16_t *buffer)
{
    int err = codec_receive_pcm(buffer, MIC_BUFFER_SAMPLES);
    if (err) {
        LOG_ERR("Failed to process PCM data: %d", err);
    }
}

void bt_ctlr_assert_handle(char *name, int type)
{
    LOG_INF("Bluetooth assert: %s (type %d)", name ? name : "NULL", type);
}

static void print_reset_reason(void)
{
    uint32_t reas = NRF_POWER->RESETREAS;

    // Clear the reset reason register
    NRF_POWER->RESETREAS = reas;

    if (reas & POWER_RESETREAS_DOG_Msk) {
        printk("Reset by WATCHDOG\n");
    } else if (reas & POWER_RESETREAS_NFC_Msk) {
        printk("Wake up by NFC field detect\n");
    } else if (reas & POWER_RESETREAS_RESETPIN_Msk) {
        printk("Reset by pin-reset\n");
    } else if (reas & POWER_RESETREAS_SREQ_Msk) {
        printk("Reset by soft-reset\n");
    } else if (reas & POWER_RESETREAS_LOCKUP_Msk) {
        printk("Reset by CPU LOCKUP\n");
    } else if (reas) {
        printk("Reset by a different source (0x%08X)\n", reas);
    } else {
        printk("Power-on-reset\n");
    }
}

bool is_connected = false;
bool is_charging = false;
extern bool is_off;
extern bool usb_charge;
extern volatile bool recording_active;
static void boot_led_sequence(void)
{
    // Red blink
    set_led_red(true);
    k_msleep(BOOT_BLINK_DURATION_MS);
    set_led_red(false);
    k_msleep(BOOT_PAUSE_DURATION_MS);
    // Green blink
    set_led_green(true);
    k_msleep(BOOT_BLINK_DURATION_MS);
    set_led_green(false);
    k_msleep(BOOT_PAUSE_DURATION_MS);
    // Blue blink
    set_led_blue(true);
    k_msleep(BOOT_BLINK_DURATION_MS);
    set_led_blue(false);
    k_msleep(BOOT_PAUSE_DURATION_MS);
    // All LEDs on
    set_led_red(true);
    set_led_green(true);
    set_led_blue(true);
    k_msleep(BOOT_BLINK_DURATION_MS);
    // All LEDs off
    set_led_red(false);
    set_led_green(false);
    set_led_blue(false);
}

void set_led_state()
{
    // Recording and connected state - BLUE

    if (usb_charge) {
        is_charging = !is_charging;
        if (is_charging) {
            set_led_green(true);
        } else {
            set_led_green(false);
        }
    } else {
        set_led_green(false);
    }
    if (is_off) {
        set_led_red(false);
        set_led_blue(false);
        return;
    }
    // Recording — RED, regardless of connection
    if (recording_active) {
        set_led_red(true);
        set_led_blue(false);
        return;
    }

    if (is_connected) {
        set_led_blue(true);
        set_led_red(false);
        return;
    }

    // Not connected — RED
    if (!is_connected) {
        set_led_red(true);
        set_led_blue(false);
        return;
    }
}

int main(void)
{
    int err;

    // Print and clear reset reason
    print_reset_reason();

    NRF_POWER->DCDCEN = 1;
    NRF_POWER->DCDCEN0 = 1;

    LOG_INF("Booting...\n");

    LOG_INF("Model: %s", CONFIG_BT_DIS_MODEL);
    LOG_INF("Firmware revision: %s", CONFIG_BT_DIS_FW_REV_STR);
    LOG_INF("Hardware revision: %s", CONFIG_BT_DIS_HW_REV_STR);
    // QSPI flash is used by MCUboot for secondary slot (OTA updates).
    // MCUmgr SMP writes new firmware images there.
    // Do NOT suspend QSPI flash — it must remain accessible for OTA.
    LOG_PRINTK("\n");
    LOG_INF("Initializing LEDs...\n");

    err = led_start();
    if (err) {
        LOG_ERR("Failed to initialize LEDs (err %d)", err);
        return err;
    }

    // Run the boot LED sequence
    boot_led_sequence();

    // Initialize watchdog early to catch any freezes during boot
    err = watchdog_init();
    if (err) {
        LOG_WRN("Watchdog init failed (err %d), continuing without watchdog", err);
    }

    // Enable battery
#ifdef CONFIG_OMI_ENABLE_BATTERY
    err = battery_init();
    if (err) {
        LOG_ERR("Battery init failed (err %d)", err);
        return err;
    }

    err = battery_charge_start();
    if (err) {
        LOG_ERR("Battery failed to start (err %d)", err);
        return err;
    }
    LOG_INF("Battery initialized");
#endif

    // Enable speaker FIRST (before button, so logs are visible)
    printk("\n=== SPEAKER INIT ===\n");
#ifdef CONFIG_OMI_ENABLE_SPEAKER
    err = speaker_init();
    if (err) {
        printk("[speaker] FAILED err=%d\n", err);
    } else {
        printk("[speaker] OK\n");
    }
#endif

    // Enable button
#ifdef CONFIG_OMI_ENABLE_BUTTON
    err = button_init();
    if (err) {
        LOG_ERR("Failed to initialize Button (err %d)", err);
        return err;
    }
    LOG_INF("Button initialized");
    activate_button_work();
    LOG_INF("Button work queue activated (D4=power, D5=input)");
#endif

    // Enable accelerometer
#ifdef CONFIG_OMI_ENABLE_ACCELEROMETER
    err = accel_start();
    if (err) {
        LOG_ERR("Accelerometer failed to activated (err %d)", err);
        return err;
    }
    LOG_INF("Accelerometer initialized");
#endif

    // Enable sdcard
#ifdef CONFIG_OMI_ENABLE_OFFLINE_STORAGE
    LOG_PRINTK("\n");
    LOG_INF("Mount SD card...\n");

    err = mount_sd_card();
    if (err) {
        LOG_ERR("Failed to mount SD card (err %d) — continuing without SD", err);
    }
    k_msleep(500);

    LOG_PRINTK("\n");
    LOG_INF("Initializing storage...\n");

    if (!err) {
        err = storage_init();
        if (err) {
            LOG_ERR("Failed to initialize storage (err %d) — continuing without storage", err);
        }
    } else {
        LOG_WRN("Skipping storage init (no SD card)");
    }
#endif

    // Haptic feedback is now via speaker (no motor).
    // init_haptic_pin() is a no-op but kept for BLE service compatibility.
    init_haptic_pin();

    // Enable usb
#ifdef CONFIG_OMI_ENABLE_USB
    LOG_PRINTK("\n");
    LOG_INF("Initializing power supply check...\n");

    err = init_usb();
    if (err) {
        LOG_ERR("Failed to initialize power supply (err %d)", err);
        return err;
    }
#endif

    // Initialize device ID from NVS (must be before transport_start)
    err = device_id_init();
    if (err) {
        LOG_WRN("Device ID init failed (err %d), using default name", err);
    }

    // Check serial port for device ID command (2 second window)
    // Format: "PINCLAW_ID=XXX\n" where XXX is 1-999
    {
        const struct device *uart = DEVICE_DT_GET(DT_CHOSEN(zephyr_console));
        if (device_is_ready(uart)) {
            LOG_INF("Listening for device ID command (2s)...");
            uint8_t cmd_buf[32];
            int cmd_pos = 0;
            int64_t deadline = k_uptime_get() + 2000;

            while (k_uptime_get() < deadline) {
                uint8_t c;
                int ret = uart_poll_in(uart, &c);
                if (ret == 0) {
                    if (c == '\n' || c == '\r') {
                        cmd_buf[cmd_pos] = '\0';
                        if (cmd_pos > 11 && strncmp((char *)cmd_buf, "PINCLAW_ID=", 11) == 0) {
                            int num = atoi((char *)cmd_buf + 11);
                            if (num > 0 && num <= 999) {
                                device_id_set((uint16_t)num);
                                printk("OK DEVICE_ID=%d NAME=%s\n", num, device_id_get_name());
                            }
                        }
                        cmd_pos = 0;
                    } else if (cmd_pos < (int)sizeof(cmd_buf) - 1) {
                        cmd_buf[cmd_pos++] = c;
                    }
                } else {
                    k_msleep(10);
                }
            }
        }
    }

    // Indicate transport initialization
    LOG_PRINTK("\n");
    LOG_INF("Initializing transport...\n");

    set_led_green(true);
    set_led_green(false);

    // Start transport
    int transportErr;
    transportErr = transport_start();
    if (transportErr) {
        LOG_ERR("Failed to start transport (err %d)", transportErr);
        // TODO: Detect the current core is app core or net core
        // Blink green LED to indicate error
        for (int i = 0; i < 5; i++) {
            set_led_green(!gpio_pin_get_dt(&led_green));
            k_msleep(200);
        }
        set_led_green(false);

        return transportErr;
    }

#ifdef CONFIG_OMI_ENABLE_SPEAKER
    play_boot_sound();
#endif

    LOG_PRINTK("\n");
    LOG_INF("Initializing codec...\n");

    set_led_blue(true);

    // Audio codec(opus) callback
    set_codec_callback(codec_handler);
    err = codec_start();
    if (err) {
        LOG_ERR("Failed to start codec: %d", err);
        // Blink blue LED to indicate error
        for (int i = 0; i < 5; i++) {
            set_led_blue(!gpio_pin_get_dt(&led_blue));
            k_msleep(200);
        }
        set_led_blue(false);
        return err;
    }

    // Boot haptic buzz via speaker (500ms low-freq rumble)
    play_haptic_milli(500);
    set_led_blue(false);

    // Indicate microphone initialization
    LOG_PRINTK("\n");
    LOG_INF("Initializing microphone...\n");

    set_led_red(true);
    set_led_green(true);

    set_mic_callback(mic_handler);
    err = mic_start();
    if (err) {
        LOG_ERR("Failed to start microphone: %d", err);
        // Blink red and green LEDs to indicate error
        for (int i = 0; i < 5; i++) {
            set_led_red(!gpio_pin_get_dt(&led_red));
            set_led_green(!gpio_pin_get_dt(&led_green));
            k_msleep(200);
        }
        set_led_red(false);
        set_led_green(false);
        return err;
    }

    set_led_red(false);
    set_led_green(false);

    // Indicate successful initialization
    LOG_PRINTK("\n");
    LOG_INF("Device initialized successfully\n");

    set_led_blue(true);
    k_msleep(1000);
    set_led_blue(false);

    // MCUboot: confirm this firmware image is working.
    // If we reach here, all critical subsystems (BLE, codec, mic) initialized OK.
    // Without confirmation, MCUboot will revert to the previous image on next reboot.
#ifdef CONFIG_BOOTLOADER_MCUBOOT
    if (!boot_is_img_confirmed()) {
        int confirm_err = boot_write_img_confirmed();
        if (confirm_err) {
            LOG_ERR("Failed to confirm firmware image: %d", confirm_err);
        } else {
            LOG_INF("Firmware image confirmed as working");
        }
    }
#endif

    // Main loop
    LOG_PRINTK("\n");
    LOG_INF("Entering main loop...\n");

    // Main loop: watchdog + LED state only.
    // Button: D4 (P0.04) = output 3.3V power, D5 (P0.05) = input read.
    // PTT logic in button.c via work queue (activate_button_work above).
    while (1) {
        watchdog_feed();
        set_led_state();
        k_msleep(20);
    }

    // Unreachable
    return 0;
}
```

## src/button.c
```c
#include "button.h"

#include <zephyr/bluetooth/bluetooth.h>
#include <zephyr/bluetooth/gatt.h>
#include <zephyr/bluetooth/l2cap.h>
#include <zephyr/bluetooth/services/bas.h>
#include <zephyr/bluetooth/uuid.h>
#include <zephyr/drivers/gpio.h>
#include <zephyr/kernel.h>
#include <zephyr/logging/log.h>
#include <zephyr/sys/poweroff.h>

#include "led.h"
#include "mic.h"
#include "speaker.h"
#include "transport.h"
#include "wdog_facade.h"
LOG_MODULE_REGISTER(button, CONFIG_LOG_DEFAULT_LEVEL);

bool is_off = false;
static void button_ccc_config_changed_handler(const struct bt_gatt_attr *attr, uint16_t value);
static ssize_t button_data_read_characteristic(struct bt_conn *conn,
                                               const struct bt_gatt_attr *attr,
                                               void *buf,
                                               uint16_t len,
                                               uint16_t offset);
static struct gpio_callback button_cb_data;

static struct bt_uuid_128 button_uuid =
    BT_UUID_INIT_128(BT_UUID_128_ENCODE(0x23BA7924, 0x0000, 0x1000, 0x7450, 0x346EAC492E92));
static struct bt_uuid_128 button_characteristic_data_uuid =
    BT_UUID_INIT_128(BT_UUID_128_ENCODE(0x23BA7925, 0x0000, 0x1000, 0x7450, 0x346EAC492E92));

static struct bt_gatt_attr button_service_attr[] = {
    BT_GATT_PRIMARY_SERVICE(&button_uuid),
    BT_GATT_CHARACTERISTIC(&button_characteristic_data_uuid.uuid,
                           BT_GATT_CHRC_READ | BT_GATT_CHRC_NOTIFY,
                           BT_GATT_PERM_READ,
                           button_data_read_characteristic,
                           NULL,
                           NULL),
    BT_GATT_CCC(button_ccc_config_changed_handler, BT_GATT_PERM_READ | BT_GATT_PERM_WRITE),
};

static struct bt_gatt_service button_service = BT_GATT_SERVICE(button_service_attr);

static void button_ccc_config_changed_handler(const struct bt_gatt_attr *attr, uint16_t value)
{
    if (value == BT_GATT_CCC_NOTIFY) {
        LOG_INF("Client subscribed for notifications");
    } else if (value == 0) {
        LOG_INF("Client unsubscribed from notifications");
    } else {
        LOG_ERR("Invalid CCC value: %u", value);
    }
}

// Pinclaw single-pin button: D4 (P0.04) = input with pull-up, switch to GND
// Pressed: D4 pulled LOW by switch → reads 0
// Released: D4 pulled HIGH by internal pull-up → reads 1
struct gpio_dt_spec d4_pin_input = {.port = DEVICE_DT_GET(DT_NODELABEL(gpio0)),
                                    .pin = 4,
                                    .dt_flags = 0};

#define BUTTON_CHECK_INTERVAL 40 // 0.04 seconds, 25 Hz

void check_button_level(struct k_work *work_item);
K_WORK_DELAYABLE_DEFINE(button_work, check_button_level);

#define SINGLE_TAP 1
#define DOUBLE_TAP 2
#define LONG_TAP 3
#define BUTTON_PRESS 4
#define BUTTON_RELEASE 5

static FSM_STATE_T current_button_state = IDLE;

static int final_button_state[2] = {0, 0};

static inline void notify_press()
{
    final_button_state[0] = BUTTON_PRESS;
    LOG_INF("Button pressed");
    struct bt_conn *conn = get_current_connection();
    if (conn != NULL) {
        bt_gatt_notify(conn, &button_service.attrs[1], &final_button_state, sizeof(final_button_state));
    }
}

static inline void notify_unpress()
{
    final_button_state[0] = BUTTON_RELEASE;
    LOG_INF("Button released");
    struct bt_conn *conn = get_current_connection();
    if (conn != NULL) {
        bt_gatt_notify(conn, &button_service.attrs[1], &final_button_state, sizeof(final_button_state));
    }
}

// Pinclaw PTT: hold > 0.5s starts recording, release stops.
// Short tap < 0.5s sends PLAY command.
void check_button_level(struct k_work *work_item)
{
    // Poll D4: active LOW (pressed = 0 when switch connects to GND)
    int raw = gpio_pin_get_raw(d4_pin_input.port, d4_pin_input.pin);
    bool pressed = (raw == 0);

    // Debug: print D4 value every 2 seconds
    static int debug_counter = 0;
    if (++debug_counter >= 50) {  // 50 * 40ms = 2s
        LOG_INF("[BTN-DBG] D4 raw=%d pressed=%d", raw, pressed);
        debug_counter = 0;
    }

    static bool was_btn_pressed = false;
    static bool btn_recording_started = false;
    static int64_t press_start_time = 0;

    extern volatile bool recording_active;
    extern uint16_t opus_seq_no;
    extern struct bt_gatt_service audio_service;

    // Button just pressed — record time, don't start recording yet
    if (pressed && !was_btn_pressed) {
        was_btn_pressed = true;
        btn_recording_started = false;
        press_start_time = k_uptime_get();
        // Stop any ongoing speaker playback
        speaker_stop();
    }

    // Button held past 0.5s — start recording
    if (pressed && was_btn_pressed && !btn_recording_started) {
        int64_t held = k_uptime_get() - press_start_time;
        if (held >= 500) {
            btn_recording_started = true;
            recording_active = true;
            opus_seq_no = 0;
            struct bt_conn *conn = get_current_connection();
            if (conn) {
                uint8_t start_pkt[6] = {0x01, 0x14, 0x00, 0x00, 0x00, 0x00};
                bt_gatt_notify(conn, &audio_service.attrs[1], start_pkt, 6);
            }
            LOG_INF("[BTN] Recording started (held > 0.5s)");
            set_led_red(true);
        }
    }

    // Button released
    if (!pressed && was_btn_pressed) {
        was_btn_pressed = false;
        int64_t duration = k_uptime_get() - press_start_time;

        if (btn_recording_started) {
            // Was recording — stop and send END
            recording_active = false;
            btn_recording_started = false;
            struct bt_conn *conn = get_current_connection();
            if (conn) {
                uint8_t end_pkt[5];
                end_pkt[0] = 0x03;
                end_pkt[1] = (opus_seq_no >> 24) & 0xFF;
                end_pkt[2] = (opus_seq_no >> 16) & 0xFF;
                end_pkt[3] = (opus_seq_no >> 8) & 0xFF;
                end_pkt[4] = opus_seq_no & 0xFF;
                bt_gatt_notify(conn, &audio_service.attrs[1], end_pkt, 5);
            }
            set_led_red(false);
            LOG_INF("[BTN] Recording stopped, frames=%d", opus_seq_no);
        } else {
            // Short tap (< 0.5s) — PLAY command
            LOG_INF("[BTN] Short tap (%lld ms) — PLAY", duration);
            struct bt_conn *conn = get_current_connection();
            if (conn) {
                uint8_t play_cmd = 0x20;
                bt_gatt_notify(conn, &audio_service.attrs[3], &play_cmd, 1);
            }
        }
    }

    k_work_reschedule(&button_work, K_MSEC(BUTTON_CHECK_INTERVAL));
}

static ssize_t button_data_read_characteristic(struct bt_conn *conn,
                                               const struct bt_gatt_attr *attr,
                                               void *buf,
                                               uint16_t len,
                                               uint16_t offset)
{
    return bt_gatt_attr_read(conn, attr, buf, len, offset, &final_button_state, sizeof(final_button_state));
}

int button_init()
{
    // XIAO BLE Sense has on-board IMU (LSM6DS3TR-C) wired to P0.04 (I2C1 SDA)
    // and P0.05 (I2C1 SCL). With CONFIG_I2C=n the driver never runs, so the
    // TWIM1 peripheral may still hold these pins. Force-disconnect before use.
    volatile uint32_t *twi1_enable = (volatile uint32_t *)(0x40004000 + 0x500);
    volatile uint32_t *twi1_scl = (volatile uint32_t *)(0x40004000 + 0x504);
    volatile uint32_t *twi1_sda = (volatile uint32_t *)(0x40004000 + 0x508);
    LOG_INF("TWIM1 before fix: EN=%d SDA=0x%08x SCL=0x%08x",
            *twi1_enable, *twi1_sda, *twi1_scl);
    *twi1_enable = 0;
    *twi1_sda = 0x80000000;  // disconnect
    *twi1_scl = 0x80000000;  // disconnect
    LOG_INF("TWIM1 disconnected from P0.04/P0.05");

    // Also check TWIM0
    volatile uint32_t *twi0_sda = (volatile uint32_t *)(0x40003000 + 0x508);
    if ((*twi0_sda & 0x1F) == 4 && !(*twi0_sda & 0x80000000)) {
        *twi0_sda = 0x80000000;
        LOG_INF("TWIM0 SDA was on P0.04, disconnected");
    }

    // D4: input with pull-up, switch connects to GND
    if (!gpio_is_ready_dt(&d4_pin_input)) {
        LOG_ERR("D4 pin not ready");
        return -1;
    }
    int err = gpio_pin_configure_dt(&d4_pin_input, GPIO_INPUT | GPIO_PULL_UP);
    if (err) {
        LOG_ERR("D4 input config failed: %d", err);
        return -1;
    }
    LOG_INF("D4 configured as input with pull-up");

    // Interrupt on both edges for responsive detection
    err = gpio_pin_interrupt_configure(d4_pin_input.port, d4_pin_input.pin, GPIO_INT_EDGE_BOTH);
    if (err) {
        LOG_ERR("D4 interrupt config failed: %d", err);
        return -1;
    }

    // Read initial state
    int d4_val = gpio_pin_get_raw(d4_pin_input.port, d4_pin_input.pin);
    LOG_INF("D4 initial value: %d (should be 1 if not pressed)", d4_val);

    return 0;
}

void activate_button_work()
{
    k_work_schedule(&button_work, K_MSEC(BUTTON_CHECK_INTERVAL));
}

void register_button_service()
{
    bt_gatt_service_register(&button_service);
}

FSM_STATE_T get_current_button_state()
{
    return current_button_state;
}

void turnoff_all()
{
    mic_off();
    accel_off();
    play_haptic_milli(50);
    speaker_off();
    k_msleep(100);
    set_led_blue(false);
    set_led_red(false);
    set_led_green(false);
    gpio_pin_interrupt_configure(d4_pin_input.port, d4_pin_input.pin, GPIO_INT_DISABLE);

    // Disable watchdog before entering system off
    int rc = watchdog_deinit();
    if (rc < 0) {
        LOG_ERR("Failed to deinitialize watchdog (%d)", rc);
    }

    NRF_USBD->INTENCLR = 0xFFFFFFFF;
    NRF_POWER->SYSTEMOFF = 1;
}

void force_button_state(FSM_STATE_T state)
{
    current_button_state = state;
}
```

## src/speaker.c
```c
#include "speaker.h"

#include <math.h>
#include <zephyr/bluetooth/gatt.h>
#include <zephyr/bluetooth/l2cap.h>
#include <zephyr/bluetooth/services/bas.h>
#include <zephyr/bluetooth/uuid.h>
#include <zephyr/device.h>
#include <zephyr/drivers/gpio.h>
#include <zephyr/drivers/i2s.h>
#include <zephyr/kernel.h>
#include <zephyr/logging/log.h>
#include <zephyr/logging/log_ctrl.h>

LOG_MODULE_REGISTER(speaker, CONFIG_LOG_DEFAULT_LEVEL);

#define MAX_BLOCK_SIZE 10000 // 24000 * 2

#define BLOCK_COUNT 2
#define SAMPLE_FREQUENCY 8000
#define NUMBER_OF_CHANNELS 2
#define PACKET_SIZE 400
#define WORD_SIZE 16
#define NUM_CHANNELS 2

#define PI 3.14159265358979323846

#define MAX_HAPTIC_DURATION 5000
K_MEM_SLAB_DEFINE_STATIC(mem_slab, MAX_BLOCK_SIZE, BLOCK_COUNT, 2);

// Flag to interrupt ongoing speaker playback
volatile bool speaker_stop_requested = false;

struct device *audio_speaker;

static void *rx_buffer;
static void *buzz_buffer;
static int16_t *ptr2;
static int16_t *clear_ptr;

static uint16_t current_length;
static uint16_t offset;

// Haptic motor removed — vibration feedback is now via speaker (I2S low-freq buzz).
// D6 (P1.11) haptic_gpio_pin is no longer used.

// Speaker amp enable moved off D4 (button pin). Using D6 (P1.11) which is unused.
// NOTE: speaker hardware doesn't work anyway (I2S/PAM8302A pin mismatch).
struct gpio_dt_spec speaker_gpio_pin = {.port = DEVICE_DT_GET(DT_NODELABEL(gpio1)),
                                        .pin = 11,
                                        .dt_flags = GPIO_INT_DISABLE};

// ble service
//

static void speaker_ccc_config_changed_handler(const struct bt_gatt_attr *attr, uint16_t value);
static ssize_t speaker_haptic_handler(struct bt_conn *conn,
                                      const struct bt_gatt_attr *attr,
                                      const void *buf,
                                      uint16_t len,
                                      uint16_t offset,
                                      uint8_t flags);

static struct bt_uuid_128 speaker_uuid =
    BT_UUID_INIT_128(BT_UUID_128_ENCODE(0xCAB1AB95, 0x2EA5, 0x4F4D, 0xBB56, 0x874B72CFC984));
static struct bt_uuid_128 speaker_haptic_uuid =
    BT_UUID_INIT_128(BT_UUID_128_ENCODE(0xCAB1AB96, 0x2EA5, 0x4F4D, 0xBB56, 0x874B72CFC984));

static struct bt_gatt_attr speaker_service_attr[] = {
    BT_GATT_PRIMARY_SERVICE(&speaker_uuid),
    BT_GATT_CHARACTERISTIC(&speaker_haptic_uuid.uuid,
                           BT_GATT_CHRC_WRITE | BT_GATT_CHRC_NOTIFY,
                           BT_GATT_PERM_WRITE,
                           NULL,
                           speaker_haptic_handler,
                           NULL),
    BT_GATT_CCC(speaker_ccc_config_changed_handler, BT_GATT_PERM_READ | BT_GATT_PERM_WRITE),
};
static struct bt_gatt_service speaker_service = BT_GATT_SERVICE(speaker_service_attr);

void register_speaker_service()
{
    bt_gatt_service_register(&speaker_service);
}

static void speaker_ccc_config_changed_handler(const struct bt_gatt_attr *attr, uint16_t value)
{
    if (value == BT_GATT_CCC_NOTIFY) {
        LOG_INF("Client subscribed for notifications");
    } else if (value == 0) {
        LOG_INF("Client unsubscribed from notifications");
    } else {
        LOG_ERR("Invalid CCC value: %u", value);
    }
}

static ssize_t speaker_haptic_handler(struct bt_conn *conn,
                                      const struct bt_gatt_attr *attr,
                                      const void *buf,
                                      uint16_t len,
                                      uint16_t offset,
                                      uint8_t flags)
{
    LOG_INF("play the haptic");

    uint8_t value = ((uint8_t *) buf)[0];
    LOG_INF("value %d  ", value);

    if (value < 1 || value > 3) {
        return 0;
    }

    if (value == 1) {
        play_haptic_milli(20);
    } else if (value == 2) {
        play_haptic_milli(50);
    } else if (value == 3) {
        play_haptic_milli(500);
    }

    return 1;
}

int speaker_init()
{
    printk("[speaker] init start\n");
    audio_speaker = device_get_binding("I2S_0");
    printk("[speaker] device_get_binding returned %p\n", audio_speaker);

    if (!audio_speaker) {
        printk("[speaker] ERROR: I2S_0 device not found!\n");
        return -1;
    }
    if (!device_is_ready(audio_speaker)) {
        printk("[speaker] ERROR: I2S_0 not ready\n");
        return -1;
    }
    printk("[speaker] I2S_0 device ready\n");

    if (gpio_is_ready_dt(&speaker_gpio_pin)) {
        LOG_PRINTK("Speaker Pin ready\n");
    } else {
        LOG_PRINTK("Error setting up speaker Pin\n");
        return -1;
    }
    if (gpio_pin_configure_dt(&speaker_gpio_pin, GPIO_OUTPUT_INACTIVE) < 0) {
        LOG_PRINTK("Error setting up Haptic Pin\n");
        return -1;
    }
    gpio_pin_set_dt(&speaker_gpio_pin, 1);

    struct i2s_config config = {
        .word_size = WORD_SIZE,                       // how long is one left/right word.
        .channels = NUMBER_OF_CHANNELS,               // how many words in a frame 2
        .format = I2S_FMT_DATA_FORMAT_LEFT_JUSTIFIED, // format
        // .format = I2S_FMT_DATA_FORMAT_I2S,
        .options =
            I2S_OPT_FRAME_CLK_MASTER | I2S_OPT_BIT_CLK_MASTER | I2S_OPT_BIT_CLK_GATED, // how to configure the mclock
        .frame_clk_freq = SAMPLE_FREQUENCY,                                            /* Sampling rate */
        .mem_slab = &mem_slab,        /* Memory slab to store rx/tx data */
        .block_size = MAX_BLOCK_SIZE, /* size of ONE memory block in bytes */
        .timeout = 2000, /* 2s timeout — prevents I2S blocking forever if hardware doesn't respond */
    };
    int err = i2s_configure(audio_speaker, I2S_DIR_TX, &config);
    if (err) {
        LOG_ERR("Failed to configure Speaker (%d)", err);
        return -1;
    }
    err = k_mem_slab_alloc(&mem_slab, &rx_buffer, K_MSEC(200));
    if (err) {
        LOG_INF("Failed to allocate memory for speaker%d)", err);
        return -1;
    }

    err = k_mem_slab_alloc(&mem_slab, &buzz_buffer, K_MSEC(200));
    if (err) {
        LOG_INF("Failed to allocate for chime (%d)", err);
        return -1;
    }

    memset(rx_buffer, 0, MAX_BLOCK_SIZE);
    memset(buzz_buffer, 0, MAX_BLOCK_SIZE);

    return 0;
}

uint16_t speak(uint16_t len, const void *buf) // direct from bt
{
    uint16_t amount = 0;
    amount = len;

    // If stop was requested, discard incoming audio data
    if (speaker_stop_requested) {
        current_length = 0;
        offset = 0;
        speaker_stop_requested = false;
        return amount;
    }

    if (len == 4) // if stage 1
    {
        current_length = ((uint32_t *) buf)[0];
        LOG_INF("About to write %u bytes", current_length);
        ptr2 = (int16_t *) rx_buffer;
        clear_ptr = (int16_t *) rx_buffer;
        speaker_stop_requested = false;
    } else { // if not stage 1
        if (current_length > PACKET_SIZE) {
            LOG_INF("Data length: %u", len);
            current_length = current_length - PACKET_SIZE;
            LOG_INF("remaining data: %u", current_length);

            for (int i = 0; i < (int) (len / 2); i++) {
                *ptr2++ = ((int16_t *) buf)[i];
                *ptr2++ = ((int16_t *) buf)[i];
            }
            offset = offset + len;
        } else if (current_length < PACKET_SIZE) {
            LOG_INF("entered the final stretch");
            LOG_INF("Data length: %u", len);
            current_length = current_length - len;
            LOG_INF("remaining data: %u", current_length);
            for (int i = 0; i < len / 2; i++) {
                *ptr2++ = ((int16_t *) buf)[i];
                *ptr2++ = ((int16_t *) buf)[i];
            }
            offset = offset + len;
            LOG_INF("offset: %u", offset);
            offset = 0;
            int res = i2s_write(audio_speaker, rx_buffer, MAX_BLOCK_SIZE);
            if (res < 0) {
                LOG_PRINTK("Failed to write I2S data: %d\n", res);
            }
            i2s_trigger(audio_speaker, I2S_DIR_TX, I2S_TRIGGER_START);
            if (res != 0) {
                LOG_PRINTK("Failed to drain I2S transmission: %d\n", res);
            }
            res = i2s_trigger(audio_speaker, I2S_DIR_TX, I2S_TRIGGER_DRAIN);
            if (res != 0) {
                LOG_PRINTK("Failed to drain I2S transmission: %d\n", res);
            }
            // Wait for playback but allow interruption
            for (int i = 0; i < 40; i++) {  // 40 x 100ms = 4s max
                if (speaker_stop_requested) {
                    i2s_trigger(audio_speaker, I2S_DIR_TX, I2S_TRIGGER_DROP);
                    speaker_stop_requested = false;
                    LOG_INF("Playback interrupted by button");
                    break;
                }
                k_sleep(K_MSEC(100));
            }

            memset(clear_ptr, 0, MAX_BLOCK_SIZE);
        }
    }
    return amount;
}

void generate_gentle_chime(int16_t *buffer, int num_samples)
{
    LOG_INF("Generating gentle chime");                                 // 2500
    const float frequencies[] = {523.25, 659.25, 783.99, 1046.50};      // C5, E5, G5, C6
    const int num_freqs = sizeof(frequencies) / sizeof(frequencies[0]); // 4

    for (int i = 0; i < num_samples; i++) {
        float t = (float) i / SAMPLE_FREQUENCY; // 0.000125
        float sample = 0;
        for (int j = 0; j < num_freqs; j++) {
            sample += sinf(2 * PI * frequencies[j] * t) * (1.0 - t);
        }
        int16_t int_sample = (int16_t) (sample / num_freqs * 32767 * 0.5);
        buffer[i * NUM_CHANNELS] = int_sample;
        buffer[i * NUM_CHANNELS + 1] = int_sample;
    }
    LOG_INF("Done generating gentle chime");
}

int play_boot_sound(void)
{
    int ret;
    int16_t *buffer = (int16_t *) buzz_buffer;
    const int samples_per_block = MAX_BLOCK_SIZE / (NUM_CHANNELS * sizeof(int16_t));

    generate_gentle_chime(buffer, samples_per_block);
    LOG_INF("Writing to speaker");
    k_sleep(K_MSEC(100));
    ret = i2s_write(audio_speaker, buffer, MAX_BLOCK_SIZE);
    if (ret) {
        LOG_ERR("Failed to write initial I2S data: %d", ret);
        return ret;
    }

    ret = i2s_trigger(audio_speaker, I2S_DIR_TX, I2S_TRIGGER_START);
    if (ret) {
        LOG_ERR("Failed to start I2S transmission: %d", ret);
        return ret;
    }

    ret = i2s_trigger(audio_speaker, I2S_DIR_TX, I2S_TRIGGER_DRAIN);
    if (ret != 0) {
        LOG_ERR("Failed to drain I2S transmission: %d", ret);
        return ret;
    }
    k_sleep(K_MSEC(3000));

    return 0;
}

int init_haptic_pin()
{
    // No GPIO haptic motor — feedback is via speaker I2S.
    // Nothing to init; speaker_init() handles I2S setup.
    LOG_INF("Haptic via speaker (no motor)");
    return 0;
}

void play_haptic_milli(uint32_t duration)
{
    if (duration > MAX_HAPTIC_DURATION) {
        LOG_ERR("Duration is too long");
        return;
    }
    if (!audio_speaker || !device_is_ready(audio_speaker)) {
        LOG_WRN("Speaker not ready for haptic buzz");
        return;
    }

    // Generate a low-frequency buzz in buzz_buffer (150 Hz square-ish wave)
    int16_t *buffer = (int16_t *) buzz_buffer;
    const int samples_per_block = MAX_BLOCK_SIZE / (NUM_CHANNELS * sizeof(int16_t));
    // Limit samples to requested duration
    int duration_samples = (SAMPLE_FREQUENCY * duration) / 1000;
    if (duration_samples > samples_per_block) {
        duration_samples = samples_per_block;
    }

    const float freq = 150.0f;  // low rumble frequency
    const float amplitude = 0.8f;
    for (int i = 0; i < samples_per_block; i++) {
        int16_t val = 0;
        if (i < duration_samples) {
            float t = (float) i / SAMPLE_FREQUENCY;
            // Square-ish wave: clipped sine for stronger tactile feel
            float s = sinf(2.0f * PI * freq * t);
            if (s > 0.3f) s = 1.0f;
            else if (s < -0.3f) s = -1.0f;
            else s = s / 0.3f;
            val = (int16_t)(s * 32767.0f * amplitude);
        }
        buffer[i * NUM_CHANNELS] = val;
        buffer[i * NUM_CHANNELS + 1] = val;
    }

    int ret = i2s_write(audio_speaker, buffer, MAX_BLOCK_SIZE);
    if (ret) {
        LOG_ERR("Haptic buzz i2s_write failed: %d", ret);
        return;
    }
    ret = i2s_trigger(audio_speaker, I2S_DIR_TX, I2S_TRIGGER_START);
    if (ret) {
        LOG_ERR("Haptic buzz i2s start failed: %d", ret);
        return;
    }
    i2s_trigger(audio_speaker, I2S_DIR_TX, I2S_TRIGGER_DRAIN);

    // Wait for playback to finish
    uint32_t wait = (duration < 100) ? 200 : duration + 100;
    k_sleep(K_MSEC(wait));
    LOG_INF("Haptic buzz %u ms via speaker", duration);
}

void speaker_stop()
{
    if (!audio_speaker || !device_is_ready(audio_speaker)) return;
    speaker_stop_requested = true;
    // Stop I2S immediately — DROP discards queued data
    i2s_trigger(audio_speaker, I2S_DIR_TX, I2S_TRIGGER_DROP);
    LOG_INF("Speaker playback stopped");
}

void speaker_off()
{

    gpio_pin_set_dt(&speaker_gpio_pin, 0);
}
```

## src/speaker.h
```c
#ifndef SPEAKER_H
#define SPEAKER_H

#include <zephyr/kernel.h>
/**
 * @brief Initialize the Speaker
 *
 * Initializes the speaker
 *
 * @return 0 if successful, negative errno code if error
 */
int speaker_init();

/**
 * @brief Endpoint function for streaming audio
 *
 * Call this function in the following way (Via ble)
 * 1. Send a 2 byte packet containing the audio data size
 * 2. Send to the ble notify id 400 byte packets (with notify), with each 2 bytes being the audio data
 * 3. Repeat step 2 until the audio data is sent. Then the speaker will automatically play the sound
 * when the audio data sent is equal to the audio data size sent in step 1
 *
 * @return The amount of data successfully sent in bytes.
 */
uint16_t speak(uint16_t len, const void *buf);

/**
 * @brief Play a chime effect
 *
 * This function plays a chime effect. Use this to check if the speaker works correctly
 *
 * @return 0 if successful, negative errno code if error
 */
int play_boot_sound();

/**
 * @brief Initialize the Haptic Pin
 *
 * On Call, activates the haptic pin
 *
 * @return 0 if successful, negative errno code if error
 */
int init_haptic_pin();

/**
 * @brief Activate the haptic pin for a given duration
 *
 * On Call, starts the haptic pin, creating a vibration for the given duration in milliseconds
 *
 * @return a sound hopefully
 */
void play_haptic_milli(uint32_t duration);

void speaker_off();

/**
 * @brief Stop any ongoing speaker playback immediately
 */
void speaker_stop();

void register_speaker_service();

#endif
```

## src/transport.h
```c
#ifndef TRANSPORT_H
#define TRANSPORT_H

#include <stdint.h>
#include <stddef.h>
#include <zephyr/drivers/sensor.h>
typedef struct sensors {

    struct sensor_value a_x;
    struct sensor_value a_y;
    struct sensor_value a_z;
    struct sensor_value g_x;
    struct sensor_value g_y;
    struct sensor_value g_z;
};
/**
 * @brief Initialize the BLE transport logic
 *
 * Initializes the BLE Logic
 *
 * @return 0 if successful, negative errno code if error
 */
int transport_start();
int broadcast_audio_packets(uint8_t *buffer, size_t size);
struct bt_conn *get_current_connection();
int bt_on();
int bt_off();

void accel_off();
#endif
```
